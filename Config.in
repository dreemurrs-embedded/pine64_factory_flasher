## configs/pinephone_pro_defconfig
```kconfig
BR2_aarch64=y
BR2_cortex_a72_a53=y
BR2_TARGET_GENERIC_HOSTNAME="pinephonepro"
BR2_TARGET_GENERIC_ISSUE="Welcome to PinePhone Pro"
# BR2_TARGET_ENABLE_ROOT_LOGIN is not set
# BR2_TARGET_GENERIC_GETTY is not set
# BR2_TARGET_GENERIC_REMOUNT_ROOTFS_RW is not set
BR2_ROOTFS_POST_BUILD_SCRIPT="$(BR2_EXTERNAL_P64FACTORY_BR_PATH)/board/pine64/pinephonepro/post-build.sh"
BR2_ROOTFS_POST_IMAGE_SCRIPT="support/scripts/genimage.sh"
BR2_ROOTFS_POST_SCRIPT_ARGS="-c $(BR2_EXTERNAL_P64FACTORY_BR_PATH)/board/pine64/pinephonepro/genimage.cfg"
BR2_LINUX_KERNEL=y
BR2_LINUX_KERNEL_CUSTOM_TARBALL=y
BR2_LINUX_KERNEL_CUSTOM_TARBALL_LOCATION="https://codeberg.org/megi/linux/archive/orange-pi-6.6-20231103-1422.tar.gz"
BR2_LINUX_KERNEL_USE_CUSTOM_CONFIG=y
BR2_LINUX_KERNEL_CUSTOM_CONFIG_FILE="$(BR2_EXTERNAL_P64FACTORY_BR_PATH)/board/pine64/pinephonepro/linux_defconfig"
BR2_LINUX_KERNEL_DTS_SUPPORT=y
BR2_LINUX_KERNEL_INTREE_DTS_NAME="rockchip/rk3399-pinephone-pro"
BR2_LINUX_KERNEL_DTB_OVERLAY_SUPPORT=y
BR2_LINUX_KERNEL_INSTALL_TARGET=y
BR2_LINUX_KERNEL_NEEDS_HOST_OPENSSL=y
# BR2_PACKAGE_IFUPDOWN_SCRIPTS is not set
# BR2_PACKAGE_URANDOM_SCRIPTS is not set
BR2_TARGET_ROOTFS_SQUASHFS=y
BR2_TARGET_ROOTFS_SQUASHFS4_ZSTD=y
BR2_TARGET_ROOTFS_SQUASHFS_EXTREME_COMP=y
# BR2_TARGET_ROOTFS_TAR is not set
BR2_TARGET_ARM_TRUSTED_FIRMWARE=y
BR2_TARGET_ARM_TRUSTED_FIRMWARE_CUSTOM_VERSION=y
BR2_TARGET_ARM_TRUSTED_FIRMWARE_CUSTOM_VERSION_VALUE="v2.9"
BR2_TARGET_ARM_TRUSTED_FIRMWARE_PLATFORM="rk3399"
BR2_TARGET_ARM_TRUSTED_FIRMWARE_IMAGES=""
BR2_TARGET_ARM_TRUSTED_FIRMWARE_NEEDS_ARM32_TOOLCHAIN=y
BR2_TARGET_UBOOT=y
BR2_TARGET_UBOOT_BUILD_SYSTEM_KCONFIG=y
BR2_TARGET_UBOOT_CUSTOM_GIT=y
BR2_TARGET_UBOOT_CUSTOM_REPO_URL="https://xff.cz/git/u-boot"
BR2_TARGET_UBOOT_CUSTOM_REPO_VERSION="ppp-2023.07"
BR2_TARGET_UBOOT_PATCH="$(BR2_EXTERNAL_P64FACTORY_BR_PATH)/board/pine64/pinephonepro/patches/uboot"
BR2_TARGET_UBOOT_USE_CUSTOM_CONFIG=y
BR2_TARGET_UBOOT_CUSTOM_CONFIG_FILE="$(BR2_EXTERNAL_P64FACTORY_BR_PATH)/board/pine64/pinephonepro/uboot_defconfig"
BR2_TARGET_UBOOT_NEEDS_PYLIBFDT=y
BR2_TARGET_UBOOT_NEEDS_PYELFTOOLS=y
BR2_TARGET_UBOOT_NEEDS_ATF_BL31=y
BR2_TARGET_UBOOT_NEEDS_ATF_BL31_ELF=y
# BR2_TARGET_UBOOT_FORMAT_BIN is not set
BR2_TARGET_UBOOT_FORMAT_CUSTOM=y
BR2_TARGET_UBOOT_FORMAT_CUSTOM_NAME="u-boot-rockchip.bin"
BR2_PACKAGE_HOST_DOSFSTOOLS=y
BR2_PACKAGE_HOST_DTC=y
BR2_PACKAGE_HOST_E2FSPROGS=y
BR2_PACKAGE_HOST_GENIMAGE=y
BR2_PACKAGE_HOST_MTOOLS=y
BR2_PACKAGE_PINE64_FACTORY_FLASHER=y
BR2_PACKAGE_PINE64_FACTORY_FLASHER_DEVICEINFO="$(BR2_EXTERNAL_P64FACTORY_BR_PATH)/board/pine64/pinephonepro/deviceinfo"
BR2_PACKAGE_PINE64_FACTORY_FLASHER_KEYMAP=y
```

## configs/pinetab2v2_defconfig
```kconfig
BR2_aarch64=y
BR2_cortex_a55=y
BR2_GLOBAL_PATCH_DIR="$(BR2_EXTERNAL_P64FACTORY_BR_PATH)/board/pine64/pinetab2/patches/"
BR2_TARGET_GENERIC_HOSTNAME="pinetab2"
BR2_TARGET_GENERIC_ISSUE="Welcome to PineTab2"
# BR2_TARGET_ENABLE_ROOT_LOGIN is not set
# BR2_TARGET_GENERIC_GETTY is not set
# BR2_TARGET_GENERIC_REMOUNT_ROOTFS_RW is not set
BR2_ROOTFS_POST_BUILD_SCRIPT="$(BR2_EXTERNAL_P64FACTORY_BR_PATH)/board/pine64/pinetab2v2/post-build.sh"
BR2_ROOTFS_POST_IMAGE_SCRIPT="$(BR2_EXTERNAL_P64FACTORY_BR_PATH)/board/pine64/pinetab2v2/post-image.sh"
BR2_LINUX_KERNEL=y
BR2_LINUX_KERNEL_CUSTOM_VERSION=y
BR2_LINUX_KERNEL_CUSTOM_VERSION_VALUE="6.7.6"
BR2_LINUX_KERNEL_USE_CUSTOM_CONFIG=y
BR2_LINUX_KERNEL_CUSTOM_CONFIG_FILE="$(BR2_EXTERNAL_P64FACTORY_BR_PATH)/board/pine64/pinetab2/linux_defconfig"
BR2_LINUX_KERNEL_DTS_SUPPORT=y
BR2_LINUX_KERNEL_INTREE_DTS_NAME="rockchip/rk3566-pinetab2-v2.0"
BR2_LINUX_KERNEL_DTB_OVERLAY_SUPPORT=y
BR2_LINUX_KERNEL_INSTALL_TARGET=y
BR2_LINUX_KERNEL_NEEDS_HOST_OPENSSL=y
BR2_PACKAGE_ROCKCHIP_RKBIN=y
BR2_PACKAGE_ROCKCHIP_RKBIN_TPL_FILENAME="bin/rk35/rk3566_ddr_1056MHz_v1.18.bin"
BR2_PACKAGE_ROCKCHIP_RKBIN_BL31_FILENAME="bin/rk35/rk3568_bl31_v1.43.elf"
# BR2_PACKAGE_IFUPDOWN_SCRIPTS is not set
# BR2_PACKAGE_URANDOM_SCRIPTS is not set
BR2_TARGET_ROOTFS_SQUASHFS=y
BR2_TARGET_ROOTFS_SQUASHFS4_ZSTD=y
BR2_TARGET_ROOTFS_SQUASHFS_EXTREME_COMP=y
# BR2_TARGET_ROOTFS_TAR is not set
BR2_TARGET_UBOOT=y
BR2_TARGET_UBOOT_BUILD_SYSTEM_KCONFIG=y
BR2_TARGET_UBOOT_CUSTOM_GIT=y
BR2_TARGET_UBOOT_CUSTOM_REPO_URL="https://github.com/Kwiboo/u-boot-rockchip.git"
BR2_TARGET_UBOOT_CUSTOM_REPO_VERSION="rk35xx-2024.01"
BR2_TARGET_UBOOT_BOARD_DEFCONFIG="pinetab2-rk3566"
BR2_TARGET_UBOOT_NEEDS_PYLIBFDT=y
BR2_TARGET_UBOOT_NEEDS_PYELFTOOLS=y
BR2_TARGET_UBOOT_NEEDS_ROCKCHIP_RKBIN=y
BR2_PACKAGE_HOST_DOSFSTOOLS=y
BR2_PACKAGE_HOST_DTC=y
BR2_PACKAGE_HOST_E2FSPROGS=y
BR2_PACKAGE_HOST_GENIMAGE=y
BR2_PACKAGE_HOST_MTOOLS=y
BR2_PACKAGE_PINE64_FACTORY_FLASHER=y
BR2_PACKAGE_PINE64_FACTORY_FLASHER_DEVICEINFO="$(BR2_EXTERNAL_P64FACTORY_BR_PATH)/board/pine64/pinetab2/deviceinfo"
BR2_PACKAGE_PINE64_FACTORY_FLASHER_KEYMAP=y
```

## package/Config.in
```kconfig
menu "Target packages"
	source "$BR2_EXTERNAL_P64FACTORY_BR_PATH/package/pine64-factory-flasher/Config.in"
endmenu
```

## package/pine64-factory-flasher/Config.in
```kconfig
config BR2_PACKAGE_PINE64_FACTORY_FLASHER
	bool "Pine64 Factory Flasher"
	select BR2_PACKAGE_DIALOG
	select BR2_PACKAGE_PV
	help
	  Factory flasing tool used by Pine64 to flash images
	  on Pine64 products.

if BR2_PACKAGE_PINE64_FACTORY_FLASHER

config BR2_PACKAGE_PINE64_FACTORY_FLASHER_EMMC
	bool "Flash eMMC"
	help
	  Specify if we want to flash eMMC or not.

if BR2_PACKAGE_PINE64_FACTORY_FLASHER_EMMC

config BR2_PACKAGE_PINE64_FACTORY_FLASHER_EMMC_IMAGE
	string "Path to eMMC image"
	help
	  eMMC image that will be flashed to the device.

endif

config BR2_PACKAGE_PINE64_FACTORY_FLASHER_SPI
	bool "Flash SPI"
	select BR2_PACKAGE_MTD
	select BR2_PACKAGE_MTD_FLASHCP
	help
	  Specify if we want to flash SPI or not.

if BR2_PACKAGE_PINE64_FACTORY_FLASHER_SPI

config BR2_PACKAGE_PINE64_FACTORY_FLASHER_SPI_IMAGE
	string "Path to SPI image"
	help
	  SPI image that will be flashed to the device
	  using mtd-utils.

endif

config BR2_PACKAGE_PINE64_FACTORY_FLASHER_DEVICEINFO
	string "Path to deviceinfo file"
	help
	  Deviceinfo file is used for providing data to
	  the flash target.

config BR2_PACKAGE_PINE64_FACTORY_FLASHER_KEYMAP
	bool "Volume Up/Down, Power keymap"
	help
	  This keymap is used on devices without keyboard
	  such as the PinePhone, PineTab.

endif
```
